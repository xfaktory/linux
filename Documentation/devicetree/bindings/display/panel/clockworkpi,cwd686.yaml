## Documentation/devicetree/bindings/display/panel/clockworkpi,cwd686.yaml
```yaml
# SPDX-License-Identifier: (GPL-2.0-only OR BSD-2-Clause)
%YAML 1.2
---
$id: http://devicetree.org/schemas/display/panel/clockworkpi,cwd686.yaml#
$schema: http://devicetree.org/meta-schemas/core.yaml#

title: ClockworkPi CWD686 6.86" IPS LCD panel

maintainers:
  - Max Fierke <max@maxfierke.com>

description: |
  The ClockworkPi CWD686 is a 6.86" ICNL9707-based IPS LCD panel used within the
  ClockworkPi DevTerm series of portable devices. The panel has a 480x1280
  resolution and uses 24 bit RGB per pixel.

allOf:
  - $ref: panel-common.yaml#

properties:
  compatible:
    const: clockworkpi,cwd686

  reg:
    description: DSI virtual channel used by that screen
    maxItems: 1

  iovcc-supply:
    description: regulator that supplies the iovcc voltage

  vci-supply:
    description: regulator that supplies the vci voltage

  reset-gpios: true
  rotation: true
  backlight: true

required:
  - compatible
  - reg
  - backlight
  - reset-gpios
  - iovcc-supply
  - vci-supply

additionalProperties: false

examples:
  - |
    #include <dt-bindings/gpio/gpio.h>

    dsi {
        #address-cells = <1>;
        #size-cells = <0>;

        panel@0 {
            compatible = "clockworkpi,cwd686";
            reg = <0>;
            backlight = <&backlight>;
            reset-gpios = <&gpio2 28 GPIO_ACTIVE_HIGH>;
            rotation = <90>;
            iovcc-supply = <&vcc_1v8>;
            vci-supply = <&vcc3v3_sys>;
        };
    };
```

## Documentation/devicetree/bindings/pwm/allwinner,sun8i-v536-pwm.yaml
```yaml
# SPDX-License-Identifier: GPL-2.0
%YAML 1.2
---
$id: http://devicetree.org/schemas/pwm/allwinner,sun8i-v536-pwm.yaml#
$schema: http://devicetree.org/meta-schemas/core.yaml#

title: Allwinner V536 PWM Device Tree Bindings

maintainers:
  - Samuel Holland <samuel@sholland.org>

properties:
  "#pwm-cells":
    const: 3

  compatible:
    enum:
      - allwinner,sun8i-v536-pwm
      - allwinner,sun20i-d1-pwm

  reg:
    maxItems: 1

  interrupts:
    maxItems: 1

  clocks:
    items:
      - description: Bus Clock
      - description: Module Clock

  clock-names:
    items:
      - const: bus
      - const: mod

  resets:
    maxItems: 1

allOf:
  - $ref: pwm.yaml#

required:
  - "#pwm-cells"
  - compatible
  - reg
  - interrupts
  - clocks
  - clock-names
  - resets

additionalProperties: false
```

## Documentation/devicetree/bindings/regulator/allwinner,sun20i-d1-analog-ldos.yaml
```yaml
# SPDX-License-Identifier: (GPL-2.0-only OR BSD-2-Clause)
%YAML 1.2
---
$id: http://devicetree.org/schemas/regulator/allwinner,sun20i-d1-analog-ldos.yaml#
$schema: http://devicetree.org/meta-schemas/core.yaml#

title: Allwinner D1 Analog LDOs

description:
  Allwinner D1 contains a set of LDOs which are designed to supply analog power
  inside and outside the SoC. They are controlled by a register within the audio
  codec MMIO space, but which is not part of the audio codec clock/reset domain,
  and so is exposed as a syscon.

maintainers:
  - Samuel Holland <samuel@sholland.org>

properties:
  compatible:
    enum:
      - allwinner,sun20i-d1-analog-ldos

  nvmem-cells:
    items:
      - description: NVMEM cell for the calibrated bandgap reference trim value

  nvmem-cell-names:
    items:
      - const: bg_trim

  syscon:
    $ref: /schemas/types.yaml#/definitions/phandle
    description: phandle of the device containing the power register

patternProperties:
  "^(aldo|hpldo)$":
    type: object
    $ref: regulator.yaml#

required:
  - compatible
  - nvmem-cells
  - nvmem-cell-names
  - syscon

unevaluatedProperties: false

examples:
  - |
    sid: efuse {
        #address-cells = <1>;
        #size-cells = <1>;

        bg_trim: bg-trim@28 {
            reg = <0x28 0x4>;
            bits = <16, 8>;
        };
    };

    ldos-analog {
        compatible = "allwinner,sun20i-d1-analog-ldos";
        nvmem-cells = <&bg_trim>;
        nvmem-cell-names = "bg_trim";
        syscon = <&codec>;

        reg_aldo: aldo {
            regulator-min-microvolt = <1800000>;
            regulator-max-microvolt = <1800000>;
        };

        reg_hpldo: hpldo {
            regulator-min-microvolt = <1800000>;
            regulator-max-microvolt = <1800000>;
        };
    };

...
```

## Documentation/devicetree/bindings/regulator/allwinner,sun20i-d1-system-ldos.yaml
```yaml
# SPDX-License-Identifier: (GPL-2.0-only OR BSD-2-Clause)
%YAML 1.2
---
$id: http://devicetree.org/schemas/regulator/allwinner,sun20i-d1-system-ldos.yaml#
$schema: http://devicetree.org/meta-schemas/core.yaml#

title: Allwinner D1 System LDOs

description:
  Allwinner D1 contains a pair of general-purpose LDOs which are designed to
  supply power inside and outside the SoC. They are controlled by a register
  within the system controller MMIO space.

maintainers:
  - Samuel Holland <samuel@sholland.org>

properties:
  compatible:
    enum:
      - allwinner,sun20i-d1-system-ldos

  syscon:
    $ref: /schemas/types.yaml#/definitions/phandle
    description: phandle of the device containing the LDO control register

patternProperties:
  "^(ldoa|ldob)$":
    type: object
    $ref: regulator.yaml#

required:
  - compatible
  - syscon

unevaluatedProperties: false

examples:
  - |
    ldos-system {
        compatible = "allwinner,sun20i-d1-system-ldos";
        syscon = <&syscon>;

        reg_ldoa: ldoa {
            regulator-min-microvolt = <1800000>;
            regulator-max-microvolt = <1800000>;
        };

        reg_ldob: ldob {
            regulator-name = "vcc-dram";
            regulator-min-microvolt = <1500000>;
            regulator-max-microvolt = <1500000>;
        };
    };

...
```

## Documentation/devicetree/bindings/sound/allwinner,sun20i-d1-codec.yaml
```yaml
# SPDX-License-Identifier: GPL-2.0
%YAML 1.2
---
$id: http://devicetree.org/schemas/sound/allwinner,sun20i-d1-codec.yaml#
$schema: http://devicetree.org/meta-schemas/core.yaml#

title: Allwinner D1 Codec Device Tree Bindings

maintainers:
  - Samuel Holland <samuel@sholland.org>

properties:
  "#address-cells": true
  "#size-cells": true

  "#sound-dai-cells":
    const: 0

  compatible:
    items:
      - enum:
          - allwinner,sun20i-d1-codec
      - const: simple-mfd
      - const: syscon

  reg:
    maxItems: 1

  ranges: true

  interrupts:
    maxItems: 1

  clocks:
    items:
      - description: Bus Clock
      - description: ADC Clock
      - description: DAC Clock
      - description: HOSC Clock (for jack detection and ramp)
      - description: LOSC Clock (for jack detection and ramp)

  clock-names:
    items:
      - const: bus
      - const: adc
      - const: dac
      - const: hosc
      - const: losc

  dmas:
    items:
      - description: RX DMA Channel
      - description: TX DMA Channel

  dma-names:
    items:
      - const: rx
      - const: tx

  resets:
    maxItems: 1

  avcc-supply:
    description: Power supply for the analog domain

  hpvcc-supply:
    description: Power supply for the headphone charge pump

  hp-det-gpio:
    maxItems: 1
    description: GPIO to enable the external amplifier

  aux-devs:
    $ref: simple-card.yaml#/definitions/aux-devs

  pin-switches:
    $ref: simple-card.yaml#/definitions/pin-switches

  routing:
    $ref: simple-card.yaml#/definitions/routing

  widgets:
    $ref: simple-card.yaml#/definitions/widgets

patternProperties:
  "^regulators@[a-z0-9]+":
    $ref: /schemas/regulator/allwinner,sun20i-d1-analog-ldos.yaml#

required:
  - "#sound-dai-cells"
  - compatible
  - reg
  - interrupts
  - clocks
  - clock-names
  - dmas
  - dma-names
  - resets

additionalProperties: false

...
```
